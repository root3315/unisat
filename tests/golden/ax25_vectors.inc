/* AUTO-GENERATED by scripts/gen_golden_vectors.py. DO NOT EDIT. */
/* Regenerate:  python scripts/gen_golden_vectors.py             */

#ifndef AX25_GOLDEN_VECTORS_INC
#define AX25_GOLDEN_VECTORS_INC

#include <stddef.h>
#include <stdint.h>

typedef struct {
  const char *description;
  int         kind;          /* 0=encode, 1=decode_raw */
  const char *dst_callsign;
  uint8_t     dst_ssid;
  const char *src_callsign;
  uint8_t     src_ssid;
  const uint8_t *info;
  size_t      info_len;
  const uint8_t *encoded;
  size_t      encoded_len;
  const uint8_t *raw_body;
  size_t      raw_body_len;
  const char *expected_status;
} ax25_golden_t;

static const uint8_t GV_INFO_0[] = { 0x00, 0x01, 0x02, 0x03, 0x04, 0x05, 0x06, 0x07, 0x08, 0x09, 0x0A, 0x0B, 0x0C,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 0x2E, 0x2F };
static const uint8_t GV_ENC_0[] = { 0x7E, 0x86, 0xA2, 0x40, 0x40, 0x40, 0x40, 0x60, 0xAA, 0x9C, 0x70, 0xA6, 0x82,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 0x01, 0x7E };
static const uint8_t GV_INFO_1[] = { 0 };
static const uint8_t GV_ENC_1[] = { 0x7E, 0x86, 0xA2, 0x40, 0x40, 0x40, 0x40, 0x60, 0xAA, 0x9C, 0x70, 0xA6, 0x82, 0xA8, 0x63, 0x03, 0xF0, 0x26, 0x0B, 0x7E };
static const uint8_t GV_INFO_2[] = { 0x00, 0x01, 0x02, 0x03, 0x04, 0x05, 0x06, 0x07, 0x08, 0x09, 0x0A, 0x0B, 0x0C,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 0xFE, 0xFF };
static const uint8_t GV_ENC_2[] = { 0x7E, 0x86, 0xA2, 0x40, 0x40, 0x40, 0x40, 0x60, 0xAA, 0x9C, 0x70, 0xA6, 0x82,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 0x00, 0x7E };
static const uint8_t GV_INFO_3[] = { 0x7E, 0x7E, 0x7E };
static const uint8_t GV_ENC_3[] = { 0x7E, 0x86, 0xA2, 0x40, 0x40, 0x40, 0x40, 0x60, 0xAA, 0x9C, 0x70, 0xA6, 0x82, 0xA8, 0x63, 0x03, 0xF0, 0xBE, 0x7C, 0xF9, 0x42, 0xBB, 0x04, 0x7E };
static const uint8_t GV_INFO_4[] = { 0xFF, 0xFF, 0xFF, 0xFF, 0xFF, 0xFF, 0xFF, 0xFF, 0xFF, 0xFF, 0xFF, 0xFF, 0xFF,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 0xFF, 0xFF };
static const uint8_t GV_ENC_4[] = { 0x7E, 0x86, 0xA2, 0x40, 0x40, 0x40, 0x40, 0x60, 0xAA, 0x9C, 0x70, 0xA6, 0x82,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 0x43, 0x7E };
static const uint8_t GV_INFO_5[] = { 0xFE, 0xFE, 0xFE, 0xFE, 0xFE, 0xFE, 0xFE, 0xFE };
static const uint8_t GV_ENC_5[] = { 0x7E, 0x86, 0xA2, 0x40, 0x40, 0x40, 0x40, 0x60, 0xAA, 0x9C, 0x70, 0xA6, 0x82, 0xA8, 0x63, 0x03, 0xF0, 0xBE, 0x7D, 0xFB, 0xF6, 0xED, 0xDB, 0xB7, 0x6F, 0xDF, 0xE6, 0x86, 0x7E };
static const uint8_t GV_INFO_6[] = { 0x1F, 0xF8, 0x1F, 0xF8, 0x1F, 0xF8, 0x1F, 0xF8 };
static const uint8_t GV_ENC_6[] = { 0x7E, 0x86, 0xA2, 0x40, 0x40, 0x40, 0x40, 0x60, 0xAA, 0x9C, 0x70, 0xA6, 0x82, 0xA8, 0x63, 0x03, 0xF0, 0x3D, 0xF0, 0x7D, 0xC0, 0xF7, 0x01, 0xDF, 0x07, 0x7C, 0x48, 0x11, 0x7E };
static const uint8_t GV_INFO_7[] = { 0xFF, 0x00, 0xFF, 0x00, 0xFF, 0x00, 0xFF, 0x00, 0xFF, 0x00, 0xFF, 0x00, 0xFF, 0x00, 0xFF, 0x00, 0xFF, 0x00, 0xFF, 0x00, 0xFF, 0x00, 0xFF, 0x00, 0xFF, 0x00, 0xFF, 0x00, 0xFF, 0x00, 0xFF, 0x00 };
static const uint8_t GV_ENC_7[] = { 0x7E, 0x86, 0xA2, 0x40, 0x40, 0x40, 0x40, 0x60, 0xAA, 0x9C, 0x70, 0xA6, 0x82,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 0x00, 0x7E };
static const uint8_t GV_INFO_8[] = { 0x58 };
static const uint8_t GV_ENC_8[] = { 0x7E, 0x86, 0xA8, 0x40, 0x40, 0x40, 0x40, 0x60, 0xAA, 0x9C, 0x40, 0x40, 0x40, 0x40, 0x61, 0x03, 0xF0, 0x58, 0x37, 0xBE, 0x01, 0x7E };
static const uint8_t GV_INFO_9[] = { 0x58 };
static const uint8_t GV_ENC_9[] = { 0x7E, 0xAA, 0x9C, 0x70, 0xA6, 0x82, 0xA8, 0x60, 0xAA, 0x9C, 0x70, 0xA6, 0x82, 0xA8, 0x61, 0x03, 0xF0, 0x58, 0x6F, 0xF3, 0x7E };
static const uint8_t GV_INFO_10[] = { 0x58 };
static const uint8_t GV_ENC_10[] = { 0x7E, 0xAA, 0x9C, 0x70, 0xA6, 0x82, 0xA8, 0xBE, 0x54, 0x39, 0xE1, 0x4C, 0x05, 0x51, 0xDF, 0x0D, 0xC0, 0x63, 0x51, 0x98, 0x02, 0x7E };
static const uint8_t GV_INFO_11[] = { 0x58 };
static const uint8_t GV_ENC_11[] = { 0x7E, 0x62, 0x64, 0x66, 0x68, 0x6A, 0x6C, 0x60, 0xAA, 0x9C, 0x70, 0xA6, 0x82, 0xA8, 0x63, 0x03, 0xF0, 0x58, 0xEC, 0xD9, 0x7E };
static const uint8_t GV_INFO_12[] = { 0x58 };
static const uint8_t GV_ENC_12[] = { 0x7E, 0x82, 0x40, 0x40, 0x40, 0x40, 0x40, 0x6E, 0x84, 0x40, 0x40, 0x40, 0x40, 0x40, 0x65, 0x03, 0xF0, 0x58, 0xA9, 0x9C, 0x7E };
static const uint8_t GV_RAW_13[] = { 0x86, 0xA2, 0x40, 0x40, 0x40, 0x40, 0x60, 0xAA, 0x9C, 0x70, 0xA6, 0x82, 0xA8, 0x62, 0xA4, 0x8A, 0xA0, 0x8A, 0x82, 0xA8, 0x61, 0x03, 0xF0, 0x58, 0xDF, 0xAC };
static const uint8_t GV_RAW_14[] = { 0x86, 0xA2, 0x40, 0x40, 0x40, 0x40, 0x60, 0xAA, 0x9C, 0x70, 0xA6, 0x82, 0xA8, 0x63, 0x03, 0xF0, 0x48, 0x69, 0xDE, 0xAD };
static const uint8_t GV_RAW_15[] = { 0x86, 0xA2, 0x40, 0x40, 0x40, 0x40, 0x60, 0xAA, 0x9C, 0x70, 0xA6, 0x82, 0xA8, 0x63, 0x99, 0xF0, 0x0B, 0xEF };
static const uint8_t GV_RAW_16[] = { 0x86, 0xA2, 0x40, 0x40, 0x40, 0x40, 0x60, 0xAA, 0x9C, 0x70, 0xA6, 0x82, 0xA8, 0x63, 0x03, 0xEE, 0xD9, 0xF2 };
static const uint8_t GV_INFO_17[] = { 0x07 };
static const uint8_t GV_ENC_17[] = { 0x7E, 0x86, 0xA2, 0x40, 0x40, 0x40, 0x40, 0x60, 0xAA, 0x9C, 0x70, 0xA6, 0x82, 0xA8, 0x63, 0x03, 0xF0, 0x0D, 0xF0, 0x01, 0x03, 0x7E };
static const uint8_t GV_INFO_18[] = { 0x07, 0x14 };
static const uint8_t GV_ENC_18[] = { 0x7E, 0x86, 0xA2, 0x40, 0x40, 0x40, 0x40, 0x60, 0xAA, 0x9C, 0x70, 0xA6, 0x82, 0xA8, 0x63, 0x03, 0xF0, 0x0D, 0x28, 0xB4, 0xBB, 0x01, 0x7E };
static const uint8_t GV_INFO_19[] = { 0x07, 0x14, 0x21, 0x2E };
static const uint8_t GV_ENC_19[] = { 0x7E, 0x86, 0xA2, 0x40, 0x40, 0x40, 0x40, 0x60, 0xAA, 0x9C, 0x70, 0xA6, 0x82, 0xA8, 0x63, 0x03, 0xF0, 0x0D, 0x28, 0x42, 0x5C, 0xE6, 0xA5, 0x00, 0x7E };
static const uint8_t GV_INFO_20[] = { 0x07, 0x14, 0x21, 0x2E, 0x3B, 0x48, 0x55, 0x62 };
static const uint8_t GV_ENC_20[] = { 0x7E, 0x86, 0xA2, 0x40, 0x40, 0x40, 0x40, 0x60, 0xAA, 0x9C, 0x70, 0xA6, 0x82, 0xA8, 0x63, 0x03, 0xF0, 0x0D, 0x28, 0x42, 0x5C, 0x76, 0x90, 0xAA, 0xC4, 0xD6, 0x72, 0x00, 0x7E };
static const uint8_t GV_INFO_21[] = { 0x07, 0x14, 0x21, 0x2E, 0x3B, 0x48, 0x55, 0x62, 0x6F, 0x7C, 0x89, 0x96, 0xA3, 0xB0, 0xBD, 0xCA };
static const uint8_t GV_ENC_21[] = { 0x7E, 0x86, 0xA2, 0x40, 0x40, 0x40, 0x40, 0x60, 0xAA, 0x9C, 0x70, 0xA6, 0x82,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 0x01, 0x7E };
static const uint8_t GV_INFO_22[] = { 0x07, 0x14, 0x21, 0x2E, 0x3B, 0x48, 0x55, 0x62, 0x6F, 0x7C, 0x89, 0x96, 0xA3, 0xB0, 0xBD, 0xCA, 0xD7, 0xE4, 0xF1, 0xFE, 0x0B, 0x18, 0x25, 0x32, 0x3F, 0x4C, 0x59, 0x66, 0x73, 0x80, 0x8D, 0x9A };
static const uint8_t GV_ENC_22[] = { 0x7E, 0x86, 0xA2, 0x40, 0x40, 0x40, 0x40, 0x60, 0xAA, 0x9C, 0x70, 0xA6, 0x82,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 0x14, 0x7E };
static const uint8_t GV_INFO_23[] = { 0x07, 0x14, 0x21, 0x2E, 0x3B, 0x48, 0x55, 0x62, 0x6F, 0x7C, 0x89, 0x96, 0xA3,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 0x2D, 0x3A };
static const uint8_t GV_ENC_23[] = { 0x7E, 0x86, 0xA2, 0x40, 0x40, 0x40, 0x40, 0x60, 0xAA, 0x9C, 0x70, 0xA6, 0x82,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 0x7C, 0x7E };
static const uint8_t GV_INFO_24[] = { 0x07, 0x14, 0x21, 0x2E, 0x3B, 0x48, 0x55, 0x62, 0x6F, 0x7C, 0x89, 0x96, 0xA3,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 0xCD, 0xDA };
static const uint8_t GV_ENC_24[] = { 0x7E, 0x86, 0xA2, 0x40, 0x40, 0x40, 0x40, 0x60, 0xAA, 0x9C, 0x70, 0xA6, 0x82,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 0x09, 0x7E };
static const uint8_t GV_INFO_25[] = { 0x07, 0x14, 0x21, 0x2E, 0x3B, 0x48, 0x55, 0x62, 0x6F, 0x7C, 0x89, 0x96, 0xA3,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 0x6D, 0x7A };
static const uint8_t GV_ENC_25[] = { 0x7E, 0x86, 0xA2, 0x40, 0x40, 0x40, 0x40, 0x60, 0xAA, 0x9C, 0x70, 0xA6, 0x82,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 0xD9, 0x7E };
static const uint8_t GV_INFO_26[] = { 0x07, 0x14, 0x21, 0x2E, 0x3B, 0x48, 0x55, 0x62, 0x6F, 0x7C, 0x89, 0x96, 0xA3,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 0xAD, 0xBA };
static const uint8_t GV_ENC_26[] = { 0x7E, 0x86, 0xA2, 0x40, 0x40, 0x40, 0x40, 0x60, 0xAA, 0x9C, 0x70, 0xA6, 0x82,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 0x00, 0x7E };
static const uint8_t GV_INFO_27[] = { 0x07, 0x14, 0x21, 0x2E, 0x3B, 0x48, 0x55, 0x62, 0x6F, 0x7C, 0x89, 0x96, 0xA3,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 0x15, 0x22 };
static const uint8_t GV_ENC_27[] = { 0x7E, 0x86, 0xA2, 0x40, 0x40, 0x40, 0x40, 0x60, 0xAA, 0x9C, 0x70, 0xA6, 0x82,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 0x01, 0x7E };

static const ax25_golden_t AX25_GOLDEN_VECTORS[] = {
  { "canonical beacon-style frame, 48 B info", 0, "CQ", 0, "UN8SAT", 1, GV_INFO_0, 48, GV_ENC_0, 69, NULL, 0, NULL },
  { "min-size UI (0 B info)", 0, "CQ", 0, "UN8SAT", 1, GV_INFO_1, 0, GV_ENC_1, 20, NULL, 0, NULL },
  { "max-size UI (256 B info)", 0, "CQ", 0, "UN8SAT", 1, GV_INFO_2, 256, GV_ENC_2, 281, NULL, 0, NULL },
  { "info contains 0x7E bytes", 0, "CQ", 0, "UN8SAT", 1, GV_INFO_3, 3, GV_ENC_3, 24, NULL, 0, NULL },
  { "info all 0xFF (worst-case stuffing growth)", 0, "CQ", 0, "UN8SAT", 1, GV_INFO_4, 64, GV_ENC_4, 97, NULL, 0, NULL },
  { "info 0xFE pattern (5 ones low nibble)", 0, "CQ", 0, "UN8SAT", 1, GV_INFO_5, 8, GV_ENC_5, 29, NULL, 0, NULL },
  { "byte-boundary 5-ones runs (REQ-AX25-016)", 0, "CQ", 0, "UN8SAT", 1, GV_INFO_6, 8, GV_ENC_6, 29, NULL, 0, NULL },
  { "alternating 0xFF/0x00", 0, "CQ", 0, "UN8SAT", 1, GV_INFO_7, 32, GV_ENC_7, 55, NULL, 0, NULL },
  { "short callsign padded with spaces", 0, "CT", 0, "UN", 0, GV_INFO_8, 1, GV_ENC_8, 22, NULL, 0, NULL },
  { "ssid 0 both sides", 0, "UN8SAT", 0, "UN8SAT", 0, GV_INFO_9, 1, GV_ENC_9, 21, NULL, 0, NULL },
  { "ssid 15 both sides", 0, "UN8SAT", 15, "UN8SAT", 15, GV_INFO_10, 1, GV_ENC_10, 22, NULL, 0, NULL },
  { "digits in callsign", 0, "123456", 0, "UN8SAT", 1, GV_INFO_11, 1, GV_ENC_11, 21, NULL, 0, NULL },
  { "single-char callsigns", 0, "A", 7, "B", 2, GV_INFO_12, 1, GV_ENC_12, 21, NULL, 0, NULL },
  { "digipeater path MUST be rejected", 1, NULL, 0, NULL, 0, NULL, 0, NULL, 0, GV_RAW_13, 26, "AX25_ERR_ADDRESS_INVALID" },
  { "bad FCS", 1, NULL, 0, NULL, 0, NULL, 0, NULL, 0, GV_RAW_14, 20, "AX25_ERR_FCS_MISMATCH" },
  { "control != 0x03", 1, NULL, 0, NULL, 0, NULL, 0, NULL, 0, GV_RAW_15, 18, "AX25_ERR_CONTROL_INVALID" },
  { "pid != 0xF0", 1, NULL, 0, NULL, 0, NULL, 0, NULL, 0, GV_RAW_16, 18, "AX25_ERR_PID_INVALID" },
  { "encode info_len=1", 0, "CQ", 0, "UN8SAT", 1, GV_INFO_17, 1, GV_ENC_17, 22, NULL, 0, NULL },
  { "encode info_len=2", 0, "CQ", 0, "UN8SAT", 1, GV_INFO_18, 2, GV_ENC_18, 23, NULL, 0, NULL },
  { "encode info_len=4", 0, "CQ", 0, "UN8SAT", 1, GV_INFO_19, 4, GV_ENC_19, 25, NULL, 0, NULL },
  { "encode info_len=8", 0, "CQ", 0, "UN8SAT", 1, GV_INFO_20, 8, GV_ENC_20, 29, NULL, 0, NULL },
  { "encode info_len=16", 0, "CQ", 0, "UN8SAT", 1, GV_INFO_21, 16, GV_ENC_21, 37, NULL, 0, NULL },
  { "encode info_len=32", 0, "CQ", 0, "UN8SAT", 1, GV_INFO_22, 32, GV_ENC_22, 53, NULL, 0, NULL },
  { "encode info_len=64", 0, "CQ", 0, "UN8SAT", 1, GV_INFO_23, 64, GV_ENC_23, 85, NULL, 0, NULL },
  { "encode info_len=96", 0, "CQ", 0, "UN8SAT", 1, GV_INFO_24, 96, GV_ENC_24, 118, NULL, 0, NULL },
  { "encode info_len=128", 0, "CQ", 0, "UN8SAT", 1, GV_INFO_25, 128, GV_ENC_25, 150, NULL, 0, NULL },
  { "encode info_len=192", 0, "CQ", 0, "UN8SAT", 1, GV_INFO_26, 192, GV_ENC_26, 216, NULL, 0, NULL },
  { "encode info_len=200", 0, "CQ", 0, "UN8SAT", 1, GV_INFO_27, 200, GV_ENC_27, 224, NULL, 0, NULL },
};

#define AX25_GOLDEN_VECTOR_COUNT 28

#endif /* AX25_GOLDEN_VECTORS_INC */
